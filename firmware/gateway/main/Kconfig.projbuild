## firmware/gateway/main/Kconfig.projbuild
```kconfig
menu "Gateway Wi-Fi configuration"

    config GATEWAY_WIFI_SSID
        string "Wi-Fi SSID"
        default ""
        help
            Name of the Wi-Fi network used by the gateway.

    config GATEWAY_WIFI_PASSWORD
        string "Wi-Fi password"
        default ""
        help
            Password for the gateway Wi-Fi network.

    config GATEWAY_HTTP_TEST_URL
        string "Gateway HTTP test URL"
        default ""
        help
            HTTP URL used to test the gateway connection.

    config GATEWAY_API_KEY
        string "Gateway API key"
        default ""
        help
            API key used by the gateway to submit sensor events.

    config GATEWAY_EVENT_URL
        string "Gateway event API URL"
        default ""
        help
            URL used by the gateway to submit sensor events.

    config GATEWAY_EVENT_LIST_URL
        string "Gateway event list API URL"
        default ""
        help
            URL used by the gateway to query sensor events.

endmenu
```
